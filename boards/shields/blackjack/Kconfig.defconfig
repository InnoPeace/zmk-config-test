## boards/shields/blackjack/Kconfig.defconfig
```kconfig
if SHIELD_BLACKJACK

config ZMK_KEYBOARD_NAME
    default "Blackjack"

endif

CONFIG_ZMK_BATTERY_REPORTING=y
CONFIG_ZMK_BATTERY_REPORT_INTERVAL=60
```
